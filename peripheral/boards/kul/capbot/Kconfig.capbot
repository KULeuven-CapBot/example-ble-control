## peripheral/boards/kul/capbot/Kconfig.capbot
```kconfig
# Select specif SoC for this board

config BOARD_CAPBOT
	select SOC_NRF52840_QIAA
```

## peripheral/boards/kul/capbot/Kconfig.defconfig
```kconfig
# Board-specific default values for Kconfig options

if BOARD_CAPBOT

config BT_CTLR
	default BT

endif # BOARD_CAPBOT
```

## peripheral/boards/kul/capbot/board.yml
```yaml
# Describe board's metadata such as: Name, Vendor, SoC, ...

board:
  name: capbot
  vendor: kul
  socs:
    - name: nrf52840
```

## peripheral/boards/kul/capbot/dts/bindings/dc-motor-hall.yml
```yaml
compatible: "dc-motor-hall"
description: A brushed DC motor


child-binding:
    properties:
        pwms:
            type: phandle-array
            required: true
            specifier-space: pwm
        hall-gpios:
            type: phandle-array
            required: true
```

## robot/boards/kul/capbot/capbot_defconfig
```kconfig
# Enable MPU
CONFIG_ARM_MPU=y

# Enable hardware stack protection
CONFIG_HW_STACK_PROTECTION=y

# Enable GPIOs
CONFIG_GPIO=y

# Enable ADC for voltage measurements
CONFIG_ADC=y

# Enable PWM for precise motor control
CONFIG_PWM=y
```
